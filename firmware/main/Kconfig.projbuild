## firmware/main/Kconfig.projbuild
```kconfig
menu "Mishka Wi-Fi Speaker"
    config MISHKA_WIFI_SSID
        string "Wi-Fi SSID"
        default ""
    config MISHKA_WIFI_PASSWORD
        string "Wi-Fi password"
        default ""
    config MISHKA_AUDIO_URL
        string "Direct HTTP/HTTPS URL to PCM WAV file (mono 16kHz 16-bit)"
        default ""
    config MISHKA_VOLUME
        int "ES8311 output volume (percent)"
        range 1 80
        default 30
    config MISHKA_REPEAT_DELAY
        int "Pause between WAV playback (seconds)"
        range 1 3600
        default 10
    config MISHKA_MQTT_HOST
        string "MQTT broker IP or hostname (empty disables Home Assistant control)"
        default ""
    config MISHKA_MQTT_PORT
        int "MQTT broker TCP port"
        range 1 65535
        default 1883
    config MISHKA_MQTT_USER
        string "MQTT username"
        default ""
    config MISHKA_MQTT_PASSWORD
        string "MQTT password"
        default ""
endmenu
```
